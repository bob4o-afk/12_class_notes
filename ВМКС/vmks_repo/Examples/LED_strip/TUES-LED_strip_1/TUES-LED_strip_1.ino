#include <Adafruit_NeoPixel.h>
#include <inttypes.h>

#define NUM_PIXELS 16

#define TOP_ROW 4
#define MID_ROW 3
#define BOT_ROW 2

#define PPM_HEADER_LENGHT 58
#define IMAGE_FILE_LENGHT 202

/*
typedef enum {RED, GREEN, BLUE, YELLOW, MAGENTA, CYAN} simple_color_t;
int display_enum(simple_color_t buff[]);
*/

int render_image(uint8_t buff[3][NUM_PIXELS][3], const uint8_t image[]);
int display_rgb(uint8_t buff[3][NUM_PIXELS][3]);

const uint8_t image_data_0[IMAGE_FILE_LENGHT] =
{
  0x50, 0x36, 0x0a, 0x23, 0x20, 0x43, 0x72, 0x65, 0x61, 0x74, 0x65, 0x64, 0x20, 0x62, 0x79, 0x20,
  0x47, 0x49, 0x4d, 0x50, 0x20, 0x76, 0x65, 0x72, 0x73, 0x69, 0x6f, 0x6e, 0x20, 0x32, 0x2e, 0x31,
  0x30, 0x2e, 0x32, 0x32, 0x20, 0x50, 0x4e, 0x4d, 0x20, 0x70, 0x6c, 0x75, 0x67, 0x2d, 0x69, 0x6e,
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  0x78, 0x97, 0x54, 0x73, 0x95, 0x52, 0x71, 0x99, 0x53, 0x75
};

const uint8_t image_data_1[IMAGE_FILE_LENGHT] = 
{
  0x50, 0x36, 0x0a, 0x23, 0x20, 0x43, 0x72, 0x65, 0x61, 0x74, 0x65, 0x64, 0x20, 0x62, 0x79, 0x20,
  0x47, 0x49, 0x4d, 0x50, 0x20, 0x76, 0x65, 0x72, 0x73, 0x69, 0x6f, 0x6e, 0x20, 0x32, 0x2e, 0x31,
  0x30, 0x2e, 0x32, 0x32, 0x20, 0x50, 0x4e, 0x4d, 0x20, 0x70, 0x6c, 0x75, 0x67, 0x2d, 0x69, 0x6e,
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  0x8e, 0x72, 0x64, 0x87, 0x6d, 0x5f, 0x82, 0x6b, 0x5d, 0x7e
};

const uint8_t image_data_2[] =
{
  0x50, 0x36, 0x0a, 0x23, 0x20, 0x43, 0x72, 0x65, 0x61, 0x74, 0x65, 0x64, 0x20, 0x62, 0x79, 0x20,
  0x47, 0x49, 0x4d, 0x50, 0x20, 0x76, 0x65, 0x72, 0x73, 0x69, 0x6f, 0x6e, 0x20, 0x32, 0x2e, 0x31,
  0x30, 0x2e, 0x32, 0x32, 0x20, 0x50, 0x4e, 0x4d, 0x20, 0x70, 0x6c, 0x75, 0x67, 0x2d, 0x69, 0x6e,
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  0x03, 0xdd, 0xfa, 0x03, 0xdd, 0xfa, 0x03, 0x00, 0x00, 0x00
};

Adafruit_NeoPixel top_row(NUM_PIXELS, TOP_ROW, NEO_GRB);
Adafruit_NeoPixel mid_row(NUM_PIXELS, MID_ROW, NEO_GRB);
Adafruit_NeoPixel bot_row(NUM_PIXELS, BOT_ROW, NEO_GRB);

void setup()
{
    pinMode(TOP_ROW, OUTPUT);
    pinMode(MID_ROW, OUTPUT);
    pinMode(BOT_ROW, OUTPUT);
    
    // LED strip initialization
    top_row.begin();
    mid_row.begin();
    bot_row.begin();
}

void loop()
{
    uint8_t frame_buffer[3][NUM_PIXELS][3] = {{{0}}};
 
    render_image(frame_buffer, image_data_2);
    display_rgb(frame_buffer);
}

int render_image(uint8_t buff[3][NUM_PIXELS][3], const uint8_t image[])
{
    if (buff == NULL || image == NULL)
        return -1;
  
    for (uint8_t row = 0; row < 3; row++)
    {
        for (uint8_t col = 0; col < NUM_PIXELS; col++)
        {
            for (uint8_t i = 0; i < 3; i++)
            {
                buff[row][col][i] = image[PPM_HEADER_LENGHT + row * NUM_PIXELS * 3 + col * 3 + i];
            }
        }
    }
  
    return 0;
}

int display_rgb(uint8_t buff[3][NUM_PIXELS][3])
{
    if (buff == NULL)
        return -1;
  
    for (uint8_t col; col < NUM_PIXELS; col++)
    {
        top_row.setPixelColor(col, top_row.Color(buff[0][col][0], buff[0][col][1], buff[0][col][2]));
        mid_row.setPixelColor(col, mid_row.Color(buff[1][col][0], buff[1][col][1], buff[1][col][2]));
        bot_row.setPixelColor(col, bot_row.Color(buff[2][col][0], buff[2][col][1], buff[2][col][2]));
    }
  
    top_row.show();
    mid_row.show();
    bot_row.show();
  
    return 0;
}
