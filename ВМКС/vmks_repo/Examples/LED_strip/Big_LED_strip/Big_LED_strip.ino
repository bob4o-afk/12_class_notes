#include <Adafruit_NeoPixel.h>
#include <inttypes.h>

#define ROWS				8
#define COLS				32
#define NUM_PIXELS			(ROWS * COLS)
#define PPM_HEADER_LENGHT	12
#define BIG_IMAGE_FILE_SIZE	780
#define DIMM				4

#define Y_U_NO_WORK
//#define STM32

#ifdef STM32
#define LED_PIN	PA2
#else
#define LED_PIN	12
#endif

int render_image(uint8_t buff[ROWS][COLS][3], const uint8_t image[]);
int display_rgb(uint8_t buff[ROWS][COLS][3]);
int display_rgb_direct(const uint8_t image[]);

static const uint8_t big_image_data[BIG_IMAGE_FILE_SIZE] =
{
	0x50, 0x36, 0x0a, 0x33, 0x32, 0x20, 0x38, 0x0a, 0x32, 0x35, 0x35, 0x0a,
	0x00, 0x00, 0x00, 0x00, 0x00, 0x00, 0x00, 0x00, 0x00, 0x00, 0x00, 0x00,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 0x00,
	0x21, 0x96, 0xf3, 0x21, 0x96, 0xf3, 0x21, 0x96, 0xf3, 0x21, 0x96, 0xf3,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 0x00,
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	0x00, 0x00, 0x00, 0x00, 0x00, 0x00, 0x00, 0x00, 0x00, 0x00, 0x00, 0x00,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 0x00
};

Adafruit_NeoPixel led_matrix(NUM_PIXELS, LED_PIN, NEO_GRB);

void setup()
{
	led_matrix.begin();
	led_matrix.fill(led_matrix.Color(0, 20 / DIMM, 6 / DIMM));
}

void loop()
{
	#ifdef Y_U_NO_WORK

	volatile uint8_t hax[27] = {0};		// Interesting values: 19, 20-31, 32, 50
	uint8_t frame_buffer[ROWS][COLS][3] = {{{0}}};

	render_image(frame_buffer, big_image_data);
	display_rgb(frame_buffer);

	#else

	display_rgb_direct(big_image_data);

	#endif
}

int render_image(uint8_t buff[ROWS][COLS][3], const uint8_t image[])
{
	size_t row_offset, col_offset;

	if (buff == NULL || image == NULL)
		return -1;

	for (uint8_t row = 0; row < ROWS; row++)
	{
		row_offset = row * COLS * 3;
		for (uint8_t col = 0; col < COLS; col++)
		{
			col_offset = col * 3;
			for (uint8_t i = 0; i < 3; i++)
			{
				buff[row][col][i] = image[PPM_HEADER_LENGHT + row_offset + col_offset + i];
			}
		}
	}

	return 0;
}

int display_rgb(uint8_t buff[ROWS][COLS][3])
{
	if (buff == NULL)
		return -1;

	for (uint8_t col = 0; col < COLS; col += 2)
	{
		for (uint8_t row = 0; row < ROWS; row++)
		{
			if (buff[row][col][0] || buff[row][col][1] || buff[row][col][2])
			{
				led_matrix.setPixelColor(col * ROWS + row,
					led_matrix.Color(buff[row][col][0] / DIMM,
									 buff[row][col][1] / DIMM,
									 buff[row][col][2] / DIMM));
			}
		}
	}
	for (uint8_t col = 1; col < COLS; col += 2)
	{
		for (uint8_t row = 0; row < ROWS; row++)
		{
			if (buff[row][col][0] || buff[row][col][1] || buff[row][col][2])
			{
				led_matrix.setPixelColor((col + 1) * ROWS - row - 1,
					led_matrix.Color(buff[row][col][0] / DIMM,
									 buff[row][col][1] / DIMM,
									 buff[row][col][2] / DIMM));
			}
		}
	}
	led_matrix.show();

	return 0;
}

int display_rgb_direct(const uint8_t image[])
{
	size_t row_offset, col_offset, offset;

	if (image == NULL)
		return -1;

	for (uint8_t col = 0; col < COLS; col += 2)
	{
		col_offset = col * 3;
		for (uint8_t row = 0; row < ROWS; row++)
		{
			row_offset = row * COLS * 3;
			offset = PPM_HEADER_LENGHT + row_offset + col_offset;
			if (image[offset] || image[offset + 1] || image[offset + 2])
			{
				led_matrix.setPixelColor(col * ROWS + row,
					led_matrix.Color(image[offset] / DIMM,
									 image[offset + 1] / DIMM,
									 image[offset + 2] / DIMM));
			}
		}
	}
	for (uint8_t col = 1; col < COLS; col += 2)
	{
		col_offset = col * 3;
		for (uint8_t row = 0; row < ROWS; row++)
		{
			row_offset = row * COLS * 3;
			offset = PPM_HEADER_LENGHT + row_offset + col_offset;
			if (image[offset] || image[offset + 1] || image[offset + 2])
			{
				led_matrix.setPixelColor((col + 1) * ROWS - row - 1,
					led_matrix.Color(image[offset] / DIMM,
									 image[offset + 1] / DIMM,
									 image[offset + 2] / DIMM));
			}
		}
	}
	led_matrix.show();

	return 0;
}
